## config/west.yml
```yaml
manifest:
  remotes:
    - name: zmkfirmware
      url-base: https://github.com/zmkfirmware
    - name: alabahuy & rizalfr
      url-base: https://github.com/alabahuy
  projects:
    - name: zmk
      remote: rizalfr
      revision: main
      import: app/west.yml
  self:
    path: config
```

## west.yml
```yaml
manifest:
  remotes:
    - name: zmkfirmware
      url-base: https://github.com/zmkfirmware
    - name: rizalfr
      url-base: https://github.com/rizalfr
  projects:
    - name: arble-config
      remote: rizalfr
      revision: main
  self:
    path: config
```
